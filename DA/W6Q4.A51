ORG 0000H
		MOV A, #38H
		ACALL CMD
		MOV A, #0EH
		ACALL CMD
		MOV A, #01H
		ACALL CMD
		MOV A, #06H
		ACALL CMD
		MOV A, #81H
		MOV DPTR, #TABLE1
AGAIN: CLR A
        MOVC A, @A+DPTR
		JZ SKIP
		MOV P2,A
		ACALL DATA1
		INC DPTR
		SJMP AGAIN
SKIP:   MOV A, #0C4H
        ACALL CMD
		MOV DPTR, #TABLE2
REPEAT2:CLR A
        MOVC A, @A+DPTR
		JZ SKIP1
		MOV P2,A
		ACALL DATA1
		INC DPTR
		SJMP REPEAT2
		SKIP1:SJMP SKIP1
		
CMD:    ACALL BUSY
        CLR P3.7
		CLR P3.6
		MOV P2, A
		SETB P3.5
		NOP
		CLR P3.5
		RET
DATA1:   ACALL BUSY
        SETB P3.7
		CLR P3.6
		MOV P2, A
		SETB P3.5
		NOP
		CLR P3.5
		RET
BUSY:   SETB P2.7
		CLR P3.7
		SETB P3.6
WAIT:   CLR P3.5
	    NOP
		SETB P3.5
		JB P2.7, WAIT
		RET
	
ORG 1000H
TABLE1:DB"MICROCONTROLLER",0
TABLE2:DB"8051",0
	END